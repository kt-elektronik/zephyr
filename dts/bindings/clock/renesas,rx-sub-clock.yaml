## dts/bindings/clock/renesas,rx-sub-clock.yaml
```yaml
# Copyright (c) 2021 KT-Elektronik, Klaucke und Partner GmbH
# SPDX-License-Identifier: Apache-2.0

description: Renesas RX65N clock control node (sub-clock)

compatible: "renesas,rx-sub-clock"

include: [clock-controller.yaml, base.yaml]

properties:
  prescale:
    type: int
    required: true
    description: prescale divider to calculate the subclock frequency from the
                 system clock frequency. Can be one of (1,2,4,8,16,32,64) in
                 general, but specific allowed values differ for the subclocks
                 of the RX65N and constraints can be interdependent (see RX651
                 User's manual section 9)

  "#clock-cells":
    const: 0
```

## dts/bindings/clock/renesas,rx-system-clock.yaml
```yaml
# Copyright (c) 2021 KT-Elektronik Klaucke und Partner GmbH
# SPDX-License-Identifier: Apache-2.0

description: Renesas RX65N Clock Controller

compatible: "renesas,rx-system-clock"

include: [clock-controller.yaml, base.yaml]

properties:
  label:
    required: true

  reg:
    required: true

  reg-names:
    required: true

  main_clock_frequency:
    required: true
    type: int
    description: main clock frequency in Hz

  "#clock-cells":
    const: 0
```

## dts/bindings/counter/nxp,imx-tmr.yaml
```yaml
# Copyright (c) 2022 KT-Elektronik, Klaucke und Partner GmbH
# SPDX-License-Identifier: Apache-2.0

description: NXP MCUX Quad Timer Channel. Each channel of each quad timer can operate independently
  and hence will be realized as a separate counter device

compatible: "nxp,imx-tmr"

include: base.yaml

properties:
  label:
    required: true

  channel:
    type: int
    required: true
    enum:
      - 0
      - 1
      - 2
      - 3

  mode:
    type: int
    required: true
    description: counting mode of the timer, see qtmr_counting_mode_t enumerator type
      of the MCUXpresso SDK
    enum:
      - 0
      - 1
      - 2
      - 3
      - 4
      - 5
      - 6
      - 7

  primary_source:
    type: int
    required: true
    description: Primary source of the timer, see qtmr_primary_count_source_t enumerator type
      of the MCUXpresso SDK
    enum:
      - 0
      - 1
      - 2
      - 3
      - 4
      - 5
      - 6
      - 7
      - 8
      - 9
      - 10
      - 11
      - 12
      - 13
      - 14
      - 15

  secondary_source:
    type: int
    required: false
    description: Secondary source of the timer, see qtmr_input_source_t enumerator type
      of the MCUXpresso SDK
    enum:
      - 0
      - 1
      - 2
      - 3

  filter_count:
    type: int
    required: false
    description: Fault filter count (0-255).

  filter_period:
    type: int
    required: false
    description: Fault filter period (0-255).

  freq:
    type: int
    required: false
    description: clock frequency (only used for external clock sources)
```

## dts/bindings/counter/renesas,rx-mtu-counter.yaml
```yaml
# Copyright (c) 2022 KT-Elektronik, Klaucke und Partner GmbH
# SPDX-License-Identifier: Apache-2.0

description: Renesas RX MTU as counter

compatible: "renesas,rx-mtu-counter"

include: ["renesas,rx-pwm.yaml"]
```

## dts/bindings/cpu/renesas,rxv2.yaml
```yaml
# Copyright (c) 2019 Nordic Semiconductor ASA
# Copyright (c) 2020 KT-Elektronik, Klaucke und Partner GmbH
# SPDX-License-Identifier: Apache-2.0

description: Renesas RX65N CPU

compatible: "renesas,RX65N"

include: cpu.yaml
```

## dts/bindings/dma/renesas,rx65n-dmac.yaml
```yaml
# Copyright (c) 2021 KT-Elektronik, Klaucke und Partner GmbH
# SPDX-License-Identifier: Apache-2.0

description: Renesas RX65N DMA controller

compatible: "renesas,rx65n-dmac"

include: dma-controller.yaml

properties:
  reg:
    required: true

  reg-names:
    required: true

  interrupts:
    required: true

  interrupt-names:
    required: true

  dma-channels:
    required: true

  clock:
    type: phandle
    required: true
    description: sub-clock responsible for this interface

  clock_subsystems:
    type: phandle-array
    required: true
    description: clock sub-system to start and stop the device

  "#dma-cells":
    required: true
    const: 1

dma-cells:
  - slot
```

## dts/bindings/ethernet/renesas,rx65n-ethernet.yaml
```yaml
# Copyright (c) 2021 KT-Elektronik, Klaucke und Partner GmbH
# SPDX-License-Identifier: Apache-2.0

description: Renesas RX65n Ethernet interface

compatible: "renesas,rx65n-ethernet"

include: ethernet.yaml

properties:
  pinmuxs:
    type: phandle-array
    required: true
    description: pinmux setting for ethernet
  gpios:
    type: phandle-array
    required: true
    description: gpio drivers to configure ethernet pins
  interface_mode:
    type: int
    required: true
    enum:
      - 0
      - 1
    description:
      interface mode for communication with the PHY, can be either 0 for MII
      (Media Independent Interface) or 1 for RMII (Reduced MII)
  phy_address:
    type: int
    required: true
    description:
      address of the PHY
  linksta:
    type: boolean
    required: false
    description:
      set if the LINKSTA pin is connected for this device
  stored_mac_address:
    type: int
    required: false
    description:
      A MAC address can be stored, usually in the RX65N data flash, and read
      from this address at startup. For verification, the 6 bytes starting at
      this address have to be repeated once and followed by a uin16_t value
      which is the sum of all bytes. The data is also ignored if it is all 0x00.

      If set and the flash contains a valid MAC address, local-mac-address and
      zephyr,random-mac-address fields are ignored.
```

## dts/bindings/flash_controller/renesas,flash-controller.yaml
```yaml
description: Renesas flash controller

compatible: "renesas,flash-controller"

include: flash-controller.yaml
```

## dts/bindings/flash_controller/renesas,rx65n-fcu.yaml
```yaml
# Copyright (c) 2021 KT-Elektronik, Klaucke und Partner GmbH
# SPDX-License-Identifier: Apache-2.0

description: Renesas RX65N Flash Control Unit

compatible: "renesas,rx65n-fcu"

include: flash-controller.yaml

properties:
  reg:
    required: true

  reg-names:
    required: true

  interrupts:
    required: true

  interrupt-names:
    required: true
```

## dts/bindings/flash_controller/renesas,rx65n-flash.yaml
```yaml
# Copyright (c) 2021 KT-Elektronik, Klaucke und Partner GmbH
# SPDX-License-Identifier: Apache-2.0

description: Renesas RX65N Flash region

compatible: "renesas,rx65n-flash"

include: base.yaml

properties:
  reg:
    required: true

  reg-names:
    required: true

  entry_bit:
    type: int
    required: true
    description: bit number of the FCUs entry register for this flash region

  write_block_size:
    type: int
    required: true
    description: minimum unit to write

  page_counts:
    type: array
    required: true
    description: number of pages of different sizes

  page_sizes:
    type: array
    required: true
    description: page sizes (corresponding to page_counts)

  program_timeout_ms:
    type: int
    required: true
    description: timeout of a single programming command in milliseconds

  erase_timeout_ms:
    type: int
    required: true
    description: timeout of a single erase command in milliseconds

  erased_undefined:
    type: boolean
    required: false
    description: if this is set, the content of erased flash is undefined. Since
      some applications expect erased flash to be recognizable by a specific
      content (0xff), this means that a blank check has to be performed for each
      block when reading.
```

## dts/bindings/gpio/renesas,rx-gpio.yaml
```yaml
# Copyright (c) 2021 KT-Elektronik, Klaucke und Partner GmbH
# SPDX-License-Identifier: Apache-2.0

description: Renesas RX GPIO node

compatible: "renesas,rx-gpio"

include: [gpio-controller.yaml, base.yaml]

properties:
    reg:
      required: true

    label:
      required: true

    "#gpio-cells":
      const: 2

    pinmux:
      type: phandle
      required: false
      description: phandle to the pinmux for this port

    irq_ctrl:
      type: phandle
      required: false
      description: interrupt pin driver

    irqs:
      type: array
      required: false
      description: pin interrupts for the device

gpio-cells:
  - pin
  - flags
```

## dts/bindings/i2c/renesas,rx-sci-i2c.yaml
```yaml
# Copyright (c) 2022 KT-Elektronik Klaucke und Partner GmbH
# SPDX-License-Identifier: Apache-2.0

description: Renesas RX Serial Communication Interface (SCI) in simple I2C mode

compatible: "renesas,rx-sci-i2c"

include: [i2c-controller.yaml, "renesas,rx-sci.yaml"]
```

## dts/bindings/interrupt-controller/renesas,rx-grp-intc.yaml
```yaml
# Copyright (c) 2021 KT-Elektronik, Klaucke und Partner GmbH
# SPDX-License-Identifier: Apache-2.0

description: Renesas RX65N pin interrupt controller

include: [interrupt-controller.yaml, base.yaml]

compatible: "renesas,rx-grp-intc"

properties:
  reg:
    required: true

  reg-names:
    required: true

  label:
    required: true

  vector:
    type: int
    required: true
    description: vector table entry (interrupt number) for the group

  prio:
    type: int
    required: true
    description: interrupt priority for the group interrupt

interrupt-cells:
  - pin_mask
```

## dts/bindings/interrupt-controller/renesas,rx-icu.yaml
```yaml
# Copyright (c) 2021 KT-Elektronik Klaucke und Partner GmbH
# SPDX-License-Identifier: Apache-2.0

description: Renesas ICU Interrupt controller
compatible: "renesas,rx-icu"

include: [interrupt-controller.yaml, base.yaml]

properties:
  reg:
    required: true

  reg-names:
    required: true

  "#interrupt-cells":
    const: 3

interrupt-cells:
  - irq
  - priority
  - flags
```

## dts/bindings/interrupt-controller/renesas,rx-intc.yaml
```yaml
# Copyright (c) 2021 KT-Elektronik, Klaucke und Partner GmbH
# SPDX-License-Identifier: Apache-2.0

description: Renesas RX65N interrupt controller

compatible: "renesas,rx-intc"

include: [interrupt-controller.yaml, base.yaml]

properties:

  "#interrupt-cells":
      const: 2

interrupt-cells:
  - irq
  - priority
```

## dts/bindings/interrupt-controller/renesas,rx-pin-intc.yaml
```yaml
# Copyright (c) 2021 KT-Elektronik, Klaucke und Partner GmbH
# SPDX-License-Identifier: Apache-2.0

description: Renesas RX65N pin interrupt controller

include: [interrupt-controller.yaml, base.yaml]

compatible: "renesas,rx-pin-intc"

properties:
  reg:
    required: true

  reg-names:
    required: true
```

## dts/bindings/pinctrl/renesas,rx-mpc.yaml
```yaml
# Copyright (c) 2021 KT-Elektronik Klaucke und Partner GmbH
# SPDX-License-Identifier: Apache-2.0

description: Rensas RX Pinmux (Multi Function Pin Controller, MPC)

compatible: "renesas,rx-mpc"

include: base.yaml

properties:
    reg:
      required: true

    "#pinmux-cells":
      type: int
      required: true
      const: 2
      description: number of items in a pinmux specifier

pinmux-cells:
  - pin
  - function
```

## dts/bindings/pinctrl/renesas,rx-pinmux.yaml
```yaml
# Copyright (c) 2021 KT Elektronik GmbH
# SPDX-License-Identifier: Apache-2.0

description: Rensas RX PINMUX

compatible: "renesas,rx-pinmux"

include: base.yaml

properties:
    reg:
      required: true
```

## dts/bindings/pwm/renesas,rx-pwm.yaml
```yaml
# Copyright (c) 2021 KT-Elektronik, Klaucke und Partner GmbH
# SPDX-License-Identifier: Apache-2.0

description: Renesas RX 16-Bit Time Pulse Unit (TPU) or Multi-Function Timer Pulse Unit (MTU) as PWM

compatible: "renesas,rx-pwm"

include: [pwm-controller.yaml, base.yaml]

properties:
  reg:
    required: true

  reg-names:
    required: true

  gpios:
    type: phandle-array
    required: true
    description: gpio drivers to configure PWM pins (up to the number of channels supported by this
      of the device)

  pinmuxs:
    type: phandle-array
    required: true
    description: pinmux settings for the PWM pins (same as gpios)

  clock:
    type: phandle
    required: true
    description: sub-clock responsible for this interface

  clock_subsystems:
    type: phandle-array
    required: true
    description: clock sub-system to start and stop the device

  bit_idx:
    type: int
    required: true
    description: which bit of the common timer start register (TSTR) and timer synchronous
      register (TSYR) to set for this device.

  counter_clear_channel:
    type: int
    required: false
    description: Choose one channel to act as counter clear channel. Not required in synchronous
      mode if another synchronous TPU/MTU has a counter clear channel defined. If neither a channel
      nor synchronous mode is chosen, it is not possible to set a period, but the TPU/MTU will use a
      constant period of 0xffff cycles.

  synchronous:
    type: boolean
    required: false
    description: if set, the device will operate in synchronous mode. All TPU/MTU devices in
      synchronous mode have the same period (in cycles, but subject to different prescaler
      settings). Only one of the synchronous devices has to specify a counter clear channel.
      Note that TPUs can be synchronous and MTUs can be synchronous but no mixed synchronizaton
      is possible

  prescaler:
    type: int
    required: true
    description: prescaler setting to use for the TPU. Valid values are in the range 0-7 but
      specifically depend on the device (see RX user's manual). Common settings are 0-3 for
      dividers PCKL/1, PCLK/4, PCLK/16 and PCLK/64.

  clock_divider:
    type: int
    required: true
    description: based on the prescaler setting but can be different for each TPU/MTU of the RX MCU.
      For details, see RX MCU User's manual.

  toer_mask:
    type: int
    required: false
    description: bit mask determining which bits to set in the timer output master enable register
      (cf MCU User's manual).

  "#pwm-cells":
    const: 2

pwm-cells:
  - channel
  - flags
```

## dts/bindings/rtc/renesas,rx-rtc.yaml
```yaml
# Copyright (c) 2021-2022 KT-Elektronik, Klaucke und Partner GmbH
# SPDX-License-Identifier: Apache-2.0

# binding for the Renesas RX RTC

description: Renesas RX RTC

compatible: "renesas,rx-rtc"

include: base.yaml

properties:
  reg:
    required: true

  reg-names:
    required: true

  label:
    required: true

  use_subclock:
    type: boolean
    required: false
    description: use the sub-clock oscillator

  subclock_drive_capacity_low:
    type: boolean
    required: false
    description: set the sub-clock oscillator drive capacity for low CL (no effect if use_subclock
      is false)

  automatic_adjustment:
    type: boolean
    required: false
    description: enable automatic adjustment

  automatic_adjustment_10s_period:
    type: boolean
    required: false
    description: automatic adjustment adjusts every 10 seconds (every minute by default)

  adjustment_value:
    type: int
    required: false
    description: adjustment value to be used (if adjustment is active) in clock cycles. The two most
      significant bits determine the direction of the adjustment
        0 0 - no adjustment
        0 1 - positive adjustment (addition to prescaler)
        1 0 - negative adjustment (subtraction from prescaler)
```

## dts/bindings/serial/renesas,rx-sci-uart.yaml
```yaml
# Copyright (c) 2022 KT-Elektronik Klaucke und Partner GmbH
# SPDX-License-Identifier: Apache-2.0

description: Renesas RX Serial Communication Interface (SCI) in asynchronous mode (UART)

compatible: "renesas,rx-sci-uart"

include: [uart-controller.yaml, "renesas,rx-sci.yaml"]
```
