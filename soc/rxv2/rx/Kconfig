## soc/rxv2/rx/Kconfig
```kconfig
# Renesas RX family

# Copyright (c) 2020 KT-Elektronik, Klaucke und Partner GmbH
# SPDX-License-Identifier: Apache-2.0

config SOC_FAMILY_RX
	bool
	select HAS_SEGGER_RTT # check if: correct	
	select BUILD_OUTPUT_MOT

if SOC_FAMILY_RX

config SOC_FAMILY
	string
	default "rx"

source "soc/rxv2/rx/*/Kconfig.soc"

endif #SOC_FAMILY_RX
```

## soc/rxv2/rx/Kconfig.defconfig
```kconfig
# Renesas RX600 family

# Copyright (c) 2021 KT-Elektronik, Klaucke und Partner GmbH
# SPDX-License-Identifier: Apache-2.0

source "soc/rxv2/rx/*/Kconfig.defconfig.series"

config BUILD_OUTPUT_HEX
	default n

config BUILD_OUTPUT_S19
	default n

config BUILD_OUTPUT_MOT
	default y

config BUILD_OUTPUT_BIN
	default n

config OUTPUT_PRINT_MEMORY_USAGE
	default y

config RX_TIMER
	default y

config BUILD_NO_GAP_FILL
	default y

config REBOOT
	default y

config PWM_RX
	default y
	depends on PWM

config ADC_RX600
	default y
	depends on ADC
```

## soc/rxv2/rx/Kconfig.soc
```kconfig
# Renesas RX600 family

# Copyright (c) 2020 KT-Elektronik, Klaucke und Partner GmbH
# SPDX-License-Identifier: Apache-2.0

source "soc/rxv2/rx/*/Kconfig.series"
```

## soc/rxv2/rx/rx65n/Kconfig.defconfig.R5F565NE
```kconfig
# Copyright (c) 2021 KT-Elektronik, Klaucke und Partner GmbH
# SPDX-License-Identifier: Apache-2.0

if SOC_R5F565NE

	config SOC
		default "r5f565ne"

endif # SOC_R5F565NE
```

## soc/rxv2/rx/rx65n/Kconfig.defconfig.series
```kconfig
# Renesas RX65N series

# Copyright (c) 2021 KT-Elektronik, Klaucke und Partner GmbH
# SPDX-License-Identifier: Apache-2.0

# Kconfig symbols common to RX65N series


if SOC_SERIES_RX65N
	config SOC_SERIES
		default "rx65n"

	config GPIO_RX
		default y
		depends on GPIO

	config PINMUX_RX
		default y
	 	depends on PINMUX

	config CLOCK_CONTROL_RX65N
		default y
		depends on CLOCK_CONTROL

endif #SOC_SERIES_RX65N
```

## soc/rxv2/rx/rx65n/Kconfig.series
```kconfig
# Renesas RX65N series

# Copyright (c) 2021 KT-Elektronik, Klaucke und Partner GmbH
# SPDX-License-Identifier: Apache-2.0

config SOC_SERIES_RX65N
	bool "RX65N Series MCU"
	select RXV2
	select CPU_RXV2
	select CPU_HAS_FPU
	select SOC_FAMILY_RX
	select CONFIG_HAS_RX_FIT
	help
	  Enable support for RX65N MCU series

config SOC_SERIES_RX66N
	bool "RX66N Series MCU"
	select RXV2
	select CPU_RXV3
	select CPU_HAS_FPU
	select SOC_FAMILY_RX
	select CONFIG_HAS_RX_FIT
	help
	  Enable support for RX65N MCU series
```

## soc/rxv2/rx/rx65n/Kconfig.soc
```kconfig
# Copyright (c) 2020 KT-Elektronik, Klaucke und Partner GmbH
# SPDX-License-Identifier: Apache-2.0

choice
	prompt "Renesas RX Family MCU Selection"
	depends on SOC_SERIES_RX65N  
  
	config SOC_R5F565NE
		bool "R5F565NE"  
endchoice
```

## soc/rxv2/rx/rx66n/Kconfig.defconfig.series
```kconfig
# Copyright (c) 2021 KT-Elektronik, Klaucke und Partner GmbH
# SPDX-License-Identifier: Apache-2.0

# Kconfig symbols common to RX66N series


if SOC_SERIES_RX66N
	config SOC_SERIES
		default "rx66n"

	config GPIO_RX
		default y
		depends on GPIO

	config PINMUX_RX
		default y
	 	depends on PINMUX

	config	CLOCK_CONTROL_RX65N
		default y
		depends on CLOCK_CONTROL

endif #SOC_SERIES_RX66N
```
