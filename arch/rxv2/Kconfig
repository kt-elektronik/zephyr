## arch/rxv2/Kconfig
```kconfig
# Renesas RX architecture configuration options

# Copyright (c) 2020 KT-Elektronik, Klaucke und Partner GmbH
# SPDX-License-Identifier: Apache-2.0

menu "Renesas RX Options"
	depends on RXV2

config ARCH
	string
	default "rxv2"

config RXV2
	bool

config CPU_RXV2
	bool
	select ARCH_HAS_USERSPACE if RXV2_MPU
	default y
	help
	  Set if the processor supports the Renesas RXv2 instruction set.

config CPU_RXV3
	bool "RXv3 CPU"
	default n
	help
	  Set if the processor supports the Renesas RXv3 instruction set.

config XIP
	default y

config CACHE_LINE_SIZE_DETECT
	bool "Detect d-cache line size at runtime"
	help
	  This option enables querying the d-cache build register for finding
	  the d-cache line size at the expense of taking more memory and code
	  and a slightly increased boot time.

	  If the CPU's d-cache line size is known in advance, disable this
	  option and manually enter the value for CACHE_LINE_SIZE.

config CACHE_LINE_SIZE
	int "Cache line size" if !CACHE_LINE_SIZE_DETECT
	default 32
	help
	  Size in bytes of a CPU d-cache line. Detect automatically at runtime
	  by selecting CACHE_LINE_SIZE_DETECT.

config NUM_IRQ_PRIO_LEVELS
	int "Number of supported interrupt priority levels"
	range 1 16
	default 16
	help
	Interrupt priorities available will be 0 to NUM_IRQ_PRIO_LEVELS-1. The
	minimum value is 1. The BSP must provide a valid default for proper
	operation.

config NUM_IRQS
	int
	default 256

config GEN_ISR_TABLES
	default y

config GEN_SW_ISR_TABLE
	default y

config GEN_IRQ_VECTOR_TABLE
	default n

config GEN_IRQ_START_VECTOR
	default 16

config INCLUDE_RESET_VECTOR # check if: TODO: adaptation required
	bool "Include Reset vector"
	help
	Include the reset vector stub, which initializes the stack and prepares
	for running C code.

config MAX_IRQ_LINES # check if: TODO: adaptation required
	int "Number of IRQ lines"
	default 128
	range 0 224
	help
	  This option specifies the number of IRQ lines in the system. It
	  determines the size of the _irq_to_interrupt_vector_table, which
	  is used to track the association between vectors and IRQ numbers.

config SYS_CLOCK_HW_CYCLES_PER_SEC
	prompt "Hardware clock cycles per second"
	default 120000000
	help
    	This option specifies hardware clock.

config DYNAMIC_INTERRUPTS
	default y

config DYNAMIC_DIRECT_INTERRUPTS # check if: TODO: adaptation required
	bool "Enable support for dynamic direct interrupts"
	depends on DYNAMIC_INTERRUPTS
	help
	  Direct interrupts are designed for performance-critical interrupt
	  handling and do not go through all of the common interrupt handling
	  code. This option enables the installation of interrupt service
	  routines for direct interrupts at runtime.
	  Note: this requires enabling support for dynamic interrupts in the
	  kernel.

config HAS_RX_FIT
	bool
	default y

config MAIN_STACK_SIZE
	default 1024

config TEST_EXTRA_STACKSIZE
	default 512

endmenu
```

## boards/rxv2/rsk_rx65n_2mb/Kconfig.board
```kconfig
# Copyright (c) 2020 KT-Elektronik, Klaucke und Partner GmbH
# SPDX-License-Identifier: Apache-2.0

# Renesas Starter Kit+ RX65N-2MB board configuration

config BOARD_RSK_RX65N_2MB
	bool "Renesas Starter Kit+ RX65N-2MB board (rsk_rx65n_mb)"
	help
	  Implementation of Renesas' R5F565NE processor family based on rx2v architecture.
```

## boards/rxv2/rsk_rx65n_2mb/Kconfig.defconfig
```kconfig
# Renesas Starter Kit+ RX65N-2MB board configuration
#
# Copyright (c) 2021 KT-Elektronik, Klaucke und Partner GmbH
# SPDX-License-Identifier: Apache-2.0

if BOARD_RSK_RX65N_2MB

	config BOARD
		default "rsk_rx65n_2mb"

	config NET_L2_ETHERNET
		default y if NETWORKING

	config ETH_RX65N
		bool "ETHERNET0"
		default y if NETWORKING

	config UART_CONSOLE
		default y if SERIAL
		depends on CONSOLE

	config UART_INTERRUPT_DRIVEN
		default y

endif # BOARD_RSK_RX65N_2MB
```

## boards/rxv2/rsk_rx65n_2mb/rsk_rx65n_2mb_defconfig
```kconfig
# Renesas Starter Kit+ RX65N-2MB board configuration
# Copyright (c) 2020 KT-Elektronik, Klaucke und Partner GmbH
# SPDX-License-Identifier: Apache-2.0

CONFIG_SOC_SERIES_RX65N=y
CONFIG_SOC_R5F565NE=y
CONFIG_BOARD_RSK_RX65N_2MB=y

# 120 MHz system clock (highest value to get a precise USB clock)
CONFIG_SYS_CLOCK_HW_CYCLES_PER_SEC=120000000

# enable GPIO
CONFIG_GPIO=y      # usage in board directory
CONFIG_GPIO_RX=y   # for gpio_rx.c in drivers/

# enable uart driver
CONFIG_SERIAL=y
# CONFIG_UART_INTERRUPT_DRIVEN=y

# enable console
CONFIG_CONSOLE=y
CONFIG_UART_CONSOLE=y
# might be added at a later stage
# CONFIG_RAM_CONSOLE=y
# CONFIG_RAM_CONSOLE_BUFFER_SIZE=1024

# enable clock configuration
CONFIG_CLOCK_CONTROL=y

# enable console output
CONFIG_PRINTK=y

### START: adapted from up_squared_adsp_defconfig ###

# CONFIG_MAIN_STACK_SIZE=2048
# CONFIG_GEN_ISR_TABLES=y
# CONFIG_GEN_IRQ_VECTOR_TABLE=n
# CONFIG_MULTI_LEVEL_INTERRUPTS=y
# CONFIG_2ND_LEVEL_INTERRUPTS=y
# CONFIG_RXV2_ICTL=y # check if: how to enable this symbol
# CONFIG_CAVS_ICTL=y
# CONFIG_BOOTLOADER_SRAM_SIZE=192

### END: adapted from up_squared_adsp_defconfig ###

# might be added at a later stage
# enable spi
# CONFIG_SPI=y

# might be added at a later stage
# enable wdt
# CONFIG_WDT=y

# might be added at a later stage
# enable pinmux
CONFIG_PINMUX=n
CONFIG_PINMUX_RX=n

# might be added at a later stage
# enable watch dog
# CONFIG_WATCHDOG=y

# might be added at a later stage
# enable secure firmware image
# CONFIG_TRUSTED_EXECUTION_SECURE=y

# might be added at a later stage
# enable i2c
# CONFIG_I2C=y

# might be added at a later stage
# Enable RTT
# CONFIG_USE_SEGGER_RTT=y

# might be added at a later stage
# additional board options
# CONFIG_GPIO_AS_PINRESET=y

# might be added at a later stage
# Zephyr Kernel Configuration
# CONFIG_XIP=n
# CONFIG_FLASH_SIZE=0
# CONFIG_FLASH_BASE_ADDRESS=0x0

# might be added at a later stage
# ADC
# CONFIG_ADC=y

# might be added at a later stage
# Floating Point Options
# CONFIG_FPU=y

# might be added at a later stage
# Kernel Options due to Low Memory (8k)
# CONFIG_MAIN_STACK_SIZE=640
# CONFIG_IDLE_STACK_SIZE=200
# CONFIG_ISR_STACK_SIZE=512

# might be added at a later stage
# Prevent Interrupt Vector Table in RAM
# CONFIG_IS_BOOTLOADER=y
# CONFIG_BOOTLOADER_SRAM_SIZE=4

# might be added at a later stage
# Enable pulse width modulation
# CONFIG_PWM=y

# might be added at a later stage
# power management
# CONFIG_SOC_POWER_MANAGEMENT=y

# Optimization for debug (-Og)
#CONFIG_DEBUG=y 
# Optimization -O0
CONFIG_NO_OPTIMIZATIONS=y 

# this is maybe better done in soc/rxv2/rx/Kconfig.defconfig
#CONFIG_BUILD_NO_GAP_FILL=y 

# only for testing in the first stage
#CONFIG_MULTITHREADING=n
```

## boards/rxv2/rtb_rx65n/Kconfig.board
```kconfig
# Copyright (c) 2021 KT-Elektronik, Klaucke und Partner GmbH
# SPDX-License-Identifier: Apache-2.0

# Renesas Target Board for RX65N configuration

config BOARD_RTB_RX65N
	bool "Renesas Target Board for RX65N"
	help
	  Implementation of Renesas' R5F565NE processor family based on rx2v architecture.
	  The following peripherals are available: uart, timer, i2c, gpio.
```

## boards/rxv2/rtb_rx65n/Kconfig.defconfig
```kconfig
# Renesas Target Board for RX65N configuration
#
# Copyright (c) 2021 KT-Elektronik, Klaucke und Partner GmbH
# SPDX-License-Identifier: Apache-2.0

if BOARD_RTB_RX65N

config BOARD
	default "rtb_rx65n"

config UART_CONSOLE
	default y if SERIAL
	depends on CONSOLE

config UART_INTERRUPT_DRIVEN
	default y

endif # BOARD_RTB_RX65N
```

## boards/rxv2/rtb_rx65n/rtb_rx65n_defconfig
```kconfig
# Renesas Target Board for RX65N configuration
# Copyright (c) 2021 KT-Elektronik, Klaucke und Partner GmbH
# SPDX-License-Identifier: Apache-2.0

CONFIG_SOC_SERIES_RX65N=y
CONFIG_BOARD_RTB_RX65N=y

# 120 MHz system clock (highest value to get a precise USB clock)
CONFIG_SYS_CLOCK_HW_CYCLES_PER_SEC=120000000

# enable GPIO
CONFIG_GPIO=y      # usage in board directory

# enable uart driver
CONFIG_SERIAL=y
# CONFIG_UART_INTERRUPT_DRIVEN=y

# enable console
CONFIG_CONSOLE=y
CONFIG_UART_CONSOLE=y
# might be added at a later stage
# CONFIG_RAM_CONSOLE=y
# CONFIG_RAM_CONSOLE_BUFFER_SIZE=1024

# enable console output
CONFIG_PRINTK=y

### START: adapted from up_squared_adsp_defconfig ###

# CONFIG_MAIN_STACK_SIZE=2048
# CONFIG_MULTI_LEVEL_INTERRUPTS=y
# CONFIG_2ND_LEVEL_INTERRUPTS=y
# CONFIG_RXV2_ICTL=y # check if: how to enable this symbol
# CONFIG_CAVS_ICTL=y
# CONFIG_BOOTLOADER_SRAM_SIZE=192

### END: adapted from up_squared_adsp_defconfig ###

# might be added at a later stage
# enable spi
# CONFIG_SPI=y

# might be added at a later stage
# enable pinmux
CONFIG_PINMUX=y

# might be added at a later stage
# enable secure firmware image
# CONFIG_TRUSTED_EXECUTION_SECURE=y

# might be added at a later stage
# enable i2c
# CONFIG_I2C=y

# might be added at a later stage
# Enable RTT
# CONFIG_USE_SEGGER_RTT=y

# might be added at a later stage
# additional board options
# CONFIG_GPIO_AS_PINRESET=y

# might be added at a later stage
# Zephyr Kernel Configuration
# CONFIG_XIP=n
# CONFIG_FLASH_SIZE=0
# CONFIG_FLASH_BASE_ADDRESS=0x0

# might be added at a later stage
# Floating Point Options
# CONFIG_FPU=y

# might be added at a later stage
# Kernel Options due to Low Memory (8k)
# CONFIG_MAIN_STACK_SIZE=640
# CONFIG_IDLE_STACK_SIZE=200
# CONFIG_ISR_STACK_SIZE=512

# might be added at a later stage
# Prevent Interrupt Vector Table in RAM
# CONFIG_IS_BOOTLOADER=y
# CONFIG_BOOTLOADER_SRAM_SIZE=4

# might be added at a later stage
# Enable pulse width modulation
# CONFIG_PWM=y

# might be added at a later stage
# power management
# CONFIG_SOC_POWER_MANAGEMENT=y

# this is maybe better done in soc/rxv2/rx/Kconfig.defconfig
#CONFIG_BUILD_NO_GAP_FILL=y

# Clock configuration
CONFIG_CLOCK_CONTROL=y

CONFIG_CLOCK_RX65N_ENABLE_MAINCLK=n
CONFIG_CLOCK_RX65N_ENABLE_HOCO=y
CONFIG_CLOCK_RX65N_HOCO_16MHZ=y

# PLL clock source selection
CONFIG_CLOCK_RX65N_PLL_SRC_HOCO=y

# PLL setting
CONFIG_CLOCK_RX65N_PLL_DIVISOR=1
CONFIG_CLOCK_RX65N_PLL_MULTIPLIER=15

# System clock input selection
CONFIG_CLOCK_RX65N_SYSCLK_SRC_PLL=y

# IWDT
CONFIG_WATCHDOG=y

# Optimization for debug (-Og)
CONFIG_DEBUG=y

# enable test RNG for development until a better RNG can be used.
CONFIG_TEST_RANDOM_GENERATOR=y
```

## drivers/adc/Kconfig.rx600
```kconfig
# Renesas RX65N ADC configuration options

# Copyright (c) 2021 KT-Elektronik, Klaucke und Partner GmbH
# SPDX-License-Identifier: Apache-2.0

config ADC_RX600
	bool "Renesas RX ADC Driver"
	depends on SOC_SERIES_RX66N
	help
	  Enables Renesas RX600 Analog-to-Digital Converter (ADC) driver
```
